## sdkconfig.defaults
```kconfig
CONFIG_COMPILER_OPTIMIZATION_SIZE=y
CONFIG_SPIRAM_SUPPORT=n
CONFIG_ESP32_SRAM_SIZE=32768
CONFIG_FREERTOS_UNICORE=y
CONFIG_BT_ENABLED=y
CONFIG_BLUEDROID_ENABLED=y
CONFIG_BTDM_CTRL_MODE_BLE_ONLY=y
```
